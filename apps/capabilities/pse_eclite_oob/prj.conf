## CMakeLists.txt
```
cmake_minimum_required(VERSION 3.8.2)

include($ENV{ZEPHYR_BASE}/cmake/app/boilerplate.cmake NO_POLICY_SCOPE)
project(pse_eclite_oob)

target_sources(app PRIVATE src/main.c)
```

## sample.yaml
```
sample:
  description: PSE ECLITE OOB APP without Shell.
  name: pse_eclite_oob
  platforms: ehl_pse_crb
common:
    tags: samples
    harness: console
    harness_config:
      type: one_line
tests:
  singlethread:
    extra_args: CONF_FILE=prj_single.conf
  test:
    tags: samples
```

## prj.conf
```kconfig
# ** PSE OOB configuration  **
CONFIG_PRINTK=y
CONFIG_SHELL=y
CONFIG_LOG=y
#CONFIG_LOG_BUFFER_SIZE=1024
CONFIG_LOG_STRDUP_MAX_STRING=80
CONFIG_LOG_STRDUP_BUF_COUNT=32
CONFIG_LOG_FUNC_NAME_PREFIX_DBG=n
CONFIG_LOG_FUNC_NAME_PREFIX_ERR=n
CONFIG_KERNEL_SHELL=y
CONFIG_THREAD_MONITOR=y
CONFIG_INIT_STACKS=y
CONFIG_BOOT_BANNER=y
CONFIG_THREAD_NAME=y
CONFIG_DEVICE_SHELL=y
CONFIG_SHELL_BACKEND_SERIAL_TX_RING_BUFFER_SIZE=64
CONFIG_TIMESLICING=n
CONFIG_KOBJECT_RODATA_AREA_EXTRA_BYTES=400

# Generic APP settings
CONFIG_CACHE_DISABLE=n
CONFIG_NEWLIB_LIBC=y
CONFIG_MAX_THREAD_BYTES=4
CONFIG_ENTROPY_GENERATOR=y
CONFIG_HEAP_MEM_POOL_SIZE=16384
CONFIG_INIT_STACKS=y
CONFIG_MAIN_STACK_SIZE=4096
CONFIG_ISR_STACK_SIZE=4096
CONFIG_SYSTEM_WORKQUEUE_STACK_SIZE=4096
#CONFIG_OFFLOAD_WORKQUEUE_STACK_SIZE=4096
CONFIG_PRIVILEGED_STACK_SIZE=4096
CONFIG_NEWLIB_LIBC_ALIGNED_HEAP_SIZE=2048
CONFIG_SYS_CLOCK_TICKS_PER_SEC=100

# ** PSE Services **
CONFIG_PMC_SERVICE=y
CONFIG_SYS_SERVICE=y
CONFIG_PM_SERVICE=y
CONFIG_PM=y
CONFIG_PM_DEVICE=y
CONFIG_PM_POLICY_RESIDENCY=y
CONFIG_HECI=y
CONFIG_HOST_SERVICE=y
CONFIG_TSN_NET_SERVICE=y
CONFIG_IPC_LOG_LEVEL_ERR=n
CONFIG_HECI_LOG_LEVEL_ERR=n

# ** Start of ECLite section **
CONFIG_ECLITE_SERVICE=y
CONFIG_ECLITE_LOG_LEVEL_ERR=y
CONFIG_PWM=y
CONFIG_PWM_LOG_LEVEL_ERR=y
CONFIG_PWM_SEDI=y
CONFIG_I2C=y
CONFIG_I2C_LOG_LEVEL_ERR=y
CONFIG_I2C_SEDI=y
CONFIG_GPIO=y
CONFIG_GPIO_LOG_LEVEL_ERR=y
CONFIG_GPIO_SEDI=y
CONFIG_ECLITE_I2C_SLAVE_NAME="I2C_2"
CONFIG_ECLITE_CHARGING_FRAMEWORK=y
CONFIG_THERMAL_ENABLE=y
CONFIG_ECLITE_THERMAL_SENSOR_GPIO_PIN=11
CONFIG_ECLITE_THERMAL_SENSOR_GPIO_NAME="GPIO_1"
CONFIG_THERM_SEN_0_I2C_SLAVE_ADDR=72
CONFIG_THERM_SEN_1_I2C_SLAVE_ADDR=73
CONFIG_THERM_SEN_2_I2C_SLAVE_ADDR=74
CONFIG_THERM_SEN_3_I2C_SLAVE_ADDR=75
CONFIG_ECLITE_FAN_PWM_PIN=7
CONFIG_ECLITE_FAN_PWM_NAME="PWM_1"
CONFIG_ECLITE_FAN_TGPIO_PIN=6
CONFIG_ECLITE_FAN_TGPIO_NAME="TGPIO_0"
CONFIG_ECLITE_UCSI_I2C_SLAVE_NAME="I2C_7"
CONFIG_ECLITE_UCSI_GPIO_NAME="GPIO_1"
CONFIG_ECLITE_UCSI_GPIO_PIN=14
CONFIG_ECLITE_UCSI_I2C_SLAVE_ADDR=8
CONFIG_ECLITE_UCSI_FRAMEWORK=y
CONFIG_ECLITE_BATTERY_BTP_GPIO_PIN=27
CONFIG_ECLITE_CHG_GPIO_PIN=5
CONFIG_ECLITE_CHG_CTRL_GPIO_PIN=5
CONFIG_CHG_I2C_SLAVE_ADDR=12
CONFIG_DMA=y
CONFIG_DMA_SEDI=y

# ** Start of OOB section **
CONFIG_OOB_SERVICE=y
CONFIG_OOB_LOGGING=0

# Socks enable
CONFIG_SOCKS=n

# Generic Networking Settings
CONFIG_NETWORKING=y
CONFIG_NET_ARP=y
CONFIG_NET_L2_ETHERNET=y
CONFIG_NET_SHELL=y
CONFIG_NET_CONTEXT_TXTIME=y
CONFIG_NET_CONTEXT_PRIORITY=y
CONFIG_NET_PROMISCUOUS_MODE=y
CONFIG_NET_CONTEXT_PRIORITY=y
CONFIG_NET_PKT_TIMESTAMP=y
CONFIG_NET_PKT_TIMESTAMP_THREAD=y
CONFIG_NET_RX_STACK_SIZE=4096
CONFIG_NET_TX_STACK_SIZE=4096
CONFIG_NET_TC_RX_COUNT=2
CONFIG_NET_TC_TX_COUNT=2
CONFIG_NET_TC_MAPPING_STRICT=y
CONFIG_NET_BUF_DATA_SIZE=512
CONFIG_NET_PKT_RX_COUNT=40
CONFIG_NET_PKT_TX_COUNT=40
CONFIG_NET_BUF_RX_COUNT=40
CONFIG_NET_BUF_TX_COUNT=40

# Network connection manager
CONFIG_NET_CONNECTION_MANAGER=y
CONFIG_NET_L2_ETHERNET_MGMT=y
CONFIG_NET_MGMT=y
CONFIG_NET_MGMT_EVENT_STACK_SIZE=1024
CONFIG_NET_MGMT_EVENT_QUEUE_SIZE=5

# Network statistics settings
CONFIG_NET_STATISTICS=y
CONFIG_NET_STATISTICS_USER_API=y
CONFIG_NET_STATISTICS_ETHERNET_VENDOR=y

# TCP settings
CONFIG_NET_TCP=y
CONFIG_NET_TCP_ACK_TIMEOUT=10000
#CONFIG_NET_TCP_ISN_RFC6528=y
#CONFIG_NET_TCP_INIT_RETRANSMISSION_TIMEOUT=5000

# Networking Socket Settings
CONFIG_NET_SOCKETS=y
CONFIG_NET_SOCKETS_SOCKOPT_TLS=y
CONFIG_NET_SOCKETS_POSIX_NAMES=y
#CONFIG_NET_SOCKETS_CONNECT_TIMEOUT=20000

# IPv6 settings
CONFIG_NET_IPV6=n
#CONFIG_NET_IPV6_RA_RDNSS=y
#CONFIG_NET_CONFIG_MY_IPV6_ADDR="2001:db8::1"
#CONFIG_NET_CONFIG_PEER_IPV6_ADDR="2001:db8::2"

# IPv4 settings
CONFIG_NET_IPV4=y
CONFIG_NET_IF_MAX_IPV4_COUNT=2
CONFIG_NET_IF_UNICAST_IPV4_ADDR_COUNT=3

# DHCPv4 settings
CONFIG_NET_DHCPV4=y

# When DHCPV4 disabled, enable NET_CONFIG_SETTINGS and use the Static IP and GW Address
CONFIG_NET_CONFIG_SETTINGS=n
#CONFIG_NET_CONFIG_MY_IPV4_ADDR="x.x.x.x"
#CONFIG_NET_CONFIG_MY_IPV4_GW="x.x.x.1"
#CONFIG_NET_CONFIG_MY_IPV4_ADDR="192.102.202.17"
#CONFIG_NET_CONFIG_MY_IPV4_GW="192.102.202.1"

# DNS settings
CONFIG_DNS_RESOLVER=y
CONFIG_DNS_SERVER_IP_ADDRESSES=y
CONFIG_DNS_SERVER1="8.8.8.8"
CONFIG_DNS_RESOLVER_ADDITIONAL_BUF_CTR=2

# MQTT Settings
CONFIG_MQTT_LIB=y
CONFIG_MQTT_LIB_TLS=y
CONFIG_MQTT_KEEPALIVE=60
#CONFIG_MQTT_CLEAN_SESSION=1

# Mbed TLS settings
CONFIG_MBEDTLS=y
CONFIG_MBEDTLS_BUILTIN=y
CONFIG_MBEDTLS_ENABLE_HEAP=y
CONFIG_MBEDTLS_HEAP_SIZE=100000
CONFIG_MBEDTLS_SSL_MAX_CONTENT_LEN=10240
CONFIG_MBEDTLS_USER_CONFIG_ENABLE=y
CONFIG_MBEDTLS_CFG_FILE="config-tls-generic.h"
CONFIG_MBEDTLS_USER_CONFIG_FILE="config-mini-tls1_2-gcm-aes512.h"
CONFIG_MBEDTLS_PEM_CERTIFICATE_FORMAT=y

# Board has no entropy driver
CONFIG_TIMER_RANDOM_GENERATOR=y
CONFIG_TEST_RANDOM_GENERATOR=y

# ** PSE Ethernet settings **
CONFIG_ETH_DWC_EQOS_INTEL_PSE_PLATDATA=y

# Only need to be enable CLOCK downscale for HFPGA
#CONFIG_PTP_CLOCK=y
CONFIG_ETH_PHY=y
CONFIG_ETH_PHY_88E1512=y
CONFIG_ETH_PHY_MARVELL=y
CONFIG_ETH_PHY_USE_C22=y
CONFIG_ETH_PHY_USE_C45=y
CONFIG_ETH_DWC_EQOS=y
#CONFIG_ETH_DWC_EQOS_PTP=y
CONFIG_ETH_DWC_EQOS_QAV=y
CONFIG_ETH_DWC_EQOS_QBU=y
CONFIG_ETH_DWC_EQOS_QBV=y
CONFIG_ETH_DWC_EQOS_RX_NAPI=y
CONFIG_ETH_DWC_EQOS_DMA_RING_SIZE=32
CONFIG_ETH_DWC_EQOS_POLL_INTERVAL=10
CONFIG_ETH_DWC_EQOS_RX_QUEUES=1
CONFIG_ETH_DWC_EQOS_TX_QUEUES=1
CONFIG_ETH_DWC_EQOS_IRQ_MODE=y

# OOB will pick Either GbE0 or GbE1
# GbE0 Configs
CONFIG_ETH_DWC_EQOS_0=y
CONFIG_ETH_DWC_EQOS_0_AUTONEG=y
CONFIG_ETH_DWC_EQOS_0_PTP=y
CONFIG_ETH_DWC_EQOS_0_QAV=y
CONFIG_ETH_DWC_EQOS_0_QBU=y
CONFIG_ETH_DWC_EQOS_0_QBV=y
CONFIG_ETH_DWC_EQOS_0_NAME="ETH_DWC_EQOS_0"

# GbE1 config
#CONFIG_ETH_DWC_EQOS_1_NAME="ETH_DWC_EQOS_1"
#CONFIG_ETH_DWC_EQOS_1=y
#CONFIG_ETH_DWC_EQOS_1_AUTONEG=y
#CONFIG_ETH_DWC_EQOS_1_PTP=y
#CONFIG_ETH_DWC_EQOS_1_QAV=y
#CONFIG_ETH_DWC_EQOS_1_QBU=y
#CONFIG_ETH_DWC_EQOS_1_QBV=y

# OOB Debug Configs
CONFIG_MBEDTLS_DEBUG=n
CONFIG_MBEDTLS_DEBUG_LEVEL=4
CONFIG_MQTT_LOG_LEVEL_DEFAULT=n
CONFIG_MQTT_LOG_LEVEL_DBG=n
CONFIG_NET_DHCPV4_LOG_LEVEL_INF=n
CONFIG_DNS_RESOLVER_LOG_LEVEL_DBG=n
CONFIG_NET_SOCKETS_LOG_LEVEL_DBG=n
CONFIG_NET_TCP_LOG_LEVEL_DBG=n
CONFIG_NET_CONFIG_LOG_LEVEL_DBG=n
CONFIG_NET_LOG=n
CONFIG_NET_BUF_LOG_LEVEL_DBG=n
CONFIG_NET_IF_LOG_LEVEL_DBG=n
CONFIG_NET_CONTEXT_LOG_LEVEL_DBG=n
CONFIG_NET_MGMT_EVENT_LOG_LEVEL_DBG=n
CONFIG_SOCKS_LOG_LEVEL_DBG=n
#CONFIG_NET_CONNECTION_MANAGER_LOG_LEVEL_DBG=n
CONFIG_NET_DEBUG_NET_PKT_ALLOC=n
CONFIG_NET_BUF_POOL_USAGE=n

# User Mode Configs
CONFIG_USERSPACE=y
CONFIG_USER_APP_FRAMEWORK=y
CONFIG_APP_FRAMEWORK_LOG=1
CONFIG_NUM_USER_APP_AND_SERVICE=4
CONFIG_MAX_NUM_DEVICE_LIST=7
# ** End of OOB section **
```

## src/main.c
```c
/*
 * Copyright (c) 2021 Intel Corporation
 *
 * SPDX-License-Identifier: Apache-2.0
 */

/**
 * @file
 * @brief Sample Application for ECLite(Embedded Controller Lite)
 * and OOB(Out-of-Band Manageability) service.
 * This example demonstrates how to enable ECLite and
 * OOB service.
 * @{
 */

/**
 * @brief How to Build sample application.
 * Please refer “IntelPSE_SDK_Get_Started_Guide” for more details on how to
 * build the sample codes.
 */

/**
 * @brief Hardware setup.
 * Please refer to the Intel(R) PSE SDK User Guide for more details
 * regarding hardware setup.
 */

/* Local Includes */
#include <fw_version.h>
#include <logging/log.h>
#include <sys/printk.h>
#include <sedi.h>
#include <shell/shell.h>
#include <shell/shell_uart.h>
#include <stdlib.h>
#include <user_app_framework/user_app_framework.h>
#include <version.h>
#include <zephyr.h>

/* @brief firmware version
 * Display PSE firmware version
 */
static int cmd_fw_version(const struct shell *shell, size_t argc, char **argv)
{

	ARG_UNUSED(shell);
	ARG_UNUSED(argc);
	ARG_UNUSED(argv);

	printk("\nFW VERSION: %s.%s.%s\n", FWVER_MAJOR, FWVER_MINOR,
	       FWVER_PATCH);
	printk("FW HW IP: %s\n", FWVER_HW_IP);
	printk("FW BUILD: DATE %s, TIME %s, BY %s@%s\n", FWVER_BUILD_DATE,
	       FWVER_BUILD_TIME, FWVER_WHOAMI, FWVER_HOST_NAME);

	printk("\n");
	return 0;
}

SHELL_CMD_REGISTER(fw_version, NULL, "Display PSE FW version", cmd_fw_version);

static void app_config(void)
{
	sedi_pm_switch_core_clock(CLOCK_FREQ_100M);
}

/* @brief main function
 * Enable PSE ECLite and OOB services. For both services,
 * the service main thread will be invoked in cooperative mode
 * and service main entry will invoke even before application main function.
 */
void app_main(void *p1, void *p2, void *p3)
{
	ARG_UNUSED(p1);
	ARG_UNUSED(p2);
	ARG_UNUSED(p3);
	printk("PSE ECLite and OOB services [%s]\n", CONFIG_BOARD);
}

DEFINE_USER_MODE_APP(3, USER_MODE_APP | K_PART_GLOBAL, app_main, 1024, NULL, 0, app_config);

/**
 * @}
 */
```
