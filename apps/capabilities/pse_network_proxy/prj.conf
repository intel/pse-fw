## CMakeLists.txt
```
# SPDX-License-Identifier: Apache-2.0

cmake_minimum_required(VERSION 3.13.1)

set(DTC_OVERLAY_FILE ${CMAKE_CURRENT_SOURCE_DIR}/pse_sram.overlay)

find_package(Zephyr REQUIRED HINTS $ENV{ZEPHYR_BASE})
project(pse_network_proxy)

target_sources(app PRIVATE src/main.c)
```

## sample.yaml
```
# Copyright (c) 2021 Intel Corporation
#
# SPDX-License-Identifier: Apache-2.0

sample:
  description: PSE NETWORK PROXY TECHNOLOGY TEST APP.
  name: pse network proxy
  platforms: intel_pse
common:
    tags: samples
    harness: console
    harness_config:
      type: one_line
tests:
  test:
    tags: samples
```

## prj.conf
```kconfig
#
# Remove the symbol # which is placed in front of the following configurations
# if you want to enable Network Proxy debug log
#
# CONFIG_NET_LOG=y
# CONFIG_ETHERNET_LOG_LEVEL_DBG=y
# CONFIG_NET_SHELL=y

#
# Enable Marvell 88E1512 Ethernet PHY driver
#
CONFIG_ETH_PHY=y
CONFIG_ETH_PHY_USE_C22=y
CONFIG_ETH_PHY_USE_C45=y
CONFIG_ETH_PHY_MARVELL=y
CONFIG_ETH_PHY_88E1512=y

#
# Enable DesginWare(R) Cores Ethernet Quality-of-Service (DWC EQOS) driver
#
CONFIG_ETH_DWC_EQOS=y
CONFIG_ETH_DWC_EQOS_TX_QUEUES=2
CONFIG_ETH_DWC_EQOS_RX_QUEUES=2
CONFIG_ETH_DWC_EQOS_DMA_RING_SIZE=16
CONFIG_ETH_DWC_EQOS_IRQ_MODE=y
CONFIG_ETH_DWC_EQOS_INTEL_PSE_PLATDATA=y

# Remove the symbol # which is placed in front of the following configurations
# if you want to enable Flexible RX Parser on DWC EQOS Ethernet driver
# CONFIG_ETH_DWC_EQOS_FLEX_RX_PARSER=y

#
# Remove the symbol # which is placed in front of the following configurations
# if you want to enable Receive New API (Rx NAPI) on DWC EQOS Ethernet driver
#
#CONFIG_ETH_DWC_EQOS_RX_NAPI=y
#CONFIG_ETH_DWC_EQOS_POLL_INTERVAL=10

#
# Enable DWC EQOS GbE Port 0
#
CONFIG_ETH_DWC_EQOS_0=y
CONFIG_ETH_DWC_EQOS_0_NAME="ETH_DWC_EQOS_0"
CONFIG_ETH_DWC_EQOS_0_AUTONEG=y
CONFIG_ETH_DWC_EQOS_0_NETWORK_PROXY=y
CONFIG_ETH_DWC_EQOS_0_EEE=y

#
# Networking
#
CONFIG_NETWORKING=y
CONFIG_NET_L2_ETHERNET=y
CONFIG_NET_IPV4=y
CONFIG_NET_TCP=y
#CONFIG_NET_TCP1=y
CONFIG_NET_TCP_ISN_RFC6528=n

#
# DFU options
#
CONFIG_TEST_RANDOM_GENERATOR=y

#
# Other Kernel Object Options
#
CONFIG_HEAP_MEM_POOL_SIZE=256

#
# Work Queue Options
#
# CONFIG_SYSTEM_WORKQUEUE_STACK_SIZE=4096

CONFIG_SYS_SERVICE=y
CONFIG_HOST_SERVICE=y
CONFIG_NUM_USER_APP_AND_SERVICE=4
```

## pse_sram.overlay
```dts
/*
 * Copyright (c) 2021 Intel Corporation
 *
 * SPDX-License-Identifier: Apache-2.0
 */

/ {
	l2sram: memory@60000000{
		device_type = "memory";
		compatible = "mmio-sram";
		label = "l2sram";
		reg = <0x60000000 0xe0000>;
	};
};
```

## src/main.c
```c
/*
 * Copyright (c) 2021 Intel Corporation.
 *
 * SPDX-License-Identifier: Apache-2.0
 *
 */

/**
 * @file
 * @brief Sample Application for ECMA-393 Network Proxy Service.
 * This example demonstates how to setup a Network Proxy Agent on DesginWare(R)
 * Cores Ethernet Quality-of-Service (DWC EQOS) GbE Port 0 by enabling
 * appropriate configuration macros in prj.conf file. Besides, this sample app
 * shows how to add shared memory support by relocating L2SRAM in
 * pse_sram.overlay. Once Host enters low power mode (S0ix), Network Proxy Agent
 * will take the ownership of DWC EQOS GbE Port 0 and reacts to incoming
 * packets according to the handling decisions configured by Host.
 * @{
 */

/**
 * @brief How to build sample application.
 * Please refer to section 6.0 in "Intel(R) Programmable Seriveces Engine SDK
 * Get Started Guide" for detailed instructions on how to build the sample
 * application.
 */

/**
 * @brief Hardware setup.
 * Please refer section 4.3.2.4 in "Intel(R) Programmable Seriveces Engine SDK
 * User Guide" for detailed instructions on how to setup the hardware for
 * Network Proxy service.
 */

/* Local Includes */
#include <sys/printk.h>
#include <sedi.h>
#include <zephyr.h>

/* @brief main function
 * Switch ARM core clock frequency and High Bandwidth (HBW) clock frequency to
 * 100 MHz at the beginning of Network Proxy service. This step is to make sure
 * Network Proxy service meets low-power energy requirement.
 *
 * Note:
 * When Network Proxy service is integrated/combined with other PSE services,
 * e.g. EClite, user should develop centralized power management API to
 * coordinate ARM core clock frequency and HBW clock frequency switching.
 */
void main(void)
{
	printk("PSE ECMA-393 Network Proxy Sample Application\n");

	/* Switch ARM core clock frequency and HBW clock frequency to 100 MHz */
	sedi_pm_switch_core_clock(CLOCK_FREQ_100M);
}

/**
 * @}
 */
```
