## apps/hello_world/sample.yaml
```yaml
# Copyright (c) 2021 Intel Corporation
#
# SPDX-License-Identifier: Apache-2.0

sample:
  description: Hello World sample, the simplest Zephyr
    application
  name: hello world
common:
    tags: introduction
    harness: console
    harness_config:
      type: one_line
      regex:
        - "Hello World! (.*)"
tests:
  sample.helloworld:
    tags: introduction
```

## apps/ref_apps/codec/capture/sample.yaml
```yaml
# Copyright (c) 2021 Intel Corporation
#
# SPDX-License-Identifier: Apache-2.0

sample:
  description: PSE Codec test app.
  name: pse codec
  platforms: intel_pse
common:
    tags: drivers samples
    depends_on: i2c i2s
    harness: i2s
    harness_config:
      type: one_line
tests:
  singlethread:
    extra_args: CONF_FILE=prj_single.conf
  test:
    tags: samples
```

## apps/samples/base_fw/user_mode_samples/sample.yaml
```yaml
# Copyright (c) 2019 Intel Corporation
#
# SPDX-License-Identifier: Apache-2.0

sample:
  description: PSE USER MODE APP AND SERVICES EXAMPLE.
  name: user mode samples
  platforms: intel_pse
common:
    tags: samples
    harness: console
    harness_config:
      type: one_line
tests:
  singlethread:
    extra_args: CONF_FILE=prj_single.conf
  test:
    tags: samples
```

## apps/samples/drivers/spi_bme280/sample.yaml
```yaml
# Copyright (c) 2021 Intel Corporation
#
# SPDX-License-Identifier: Apache-2.0

sample:
  description: PSE spi sample app
  name: pse spi bme280
  platforms: ehl_pse_crb
common:
    tags: samples
    harness: console
    harness_config:
      type: one_line
tests:
  singlethread:
    extra_args: CONF_FILE=prj_single.conf
  test:
    tags: samples
```

## services/Kconfig
```kconfig
#Placeholder to add Kconfig other services like eclite, oob, etc
#Uncomment below placeholder when the respective services is enabled.

rsource "sys_service/Kconfig"
#rsource "ehl-oob/Kconfig"
rsource "eclite_fw/Kconfig"
rsource "tsn_network_service/Kconfig"
rsource "user_app_framework/Kconfig"
rsource "fw_version/Kconfig"
```

## services/eclite_fw/Kconfig
```kconfig
# Kconfig - ECLite configuration options

#
# Copyright (c) 2015 Intel Corporation
#
# SPDX-License-Identifier: Apache-2.0
#

module = ECLITE
module-str = eclite
source "subsys/logging/Kconfig.template.log_config"

config ECLITE_SERVICE
	bool "Eclite Service"
	select SYS_SERVICE
	select PMC_SERVICE
	select PM_SERVICE
	help
		Enable EC Lite service.

config  ECLITE_I2C_SLAVE_NAME
	string "I2C for all ECLITE devices"
	default "I2C_2"
	help
		Build settings to run on the HFPGA

config ECLITE_CHARGING_FRAMEWORK
	bool "enable EcLite Charging Framework"
	default n
	help
		Enable Eclite charging framework

config  ECLITE_BATTERY_BTP_GPIO_NAME
	string "GPIO Cotroller Name for BTP"
	default  "GPIO_0"
	help
		GPIO controller to be used by charging framework

config  ECLITE_BATTERY_BTP_GPIO_PIN
	int "GPIO pin for BTP"
	default  13
	help
		GPIO pin to be used for BTP by charging framework

config  ECLITE_CHG_GPIO_NAME
	string "GPIO Cotroller Name for charger present"
	default  "GPIO_0"
	help
		GPIO controller to be used by charging framework

config  ECLITE_UCSI_GPIO_NAME
	string "GPIO controller name for UCSI present"
	default  "GPIO_1"
	help
		GPIO controller to be used by UCSI framework

config  ECLITE_UCSI_GPIO_PIN
	int "GPIO for UCSI"
	default 14
	help
		GPIO pin to be used for UCSI

config  ECLITE_UCSI_I2C_SLAVE_ADDR
	int "I2C slave address for ucsi"
	default 8
	help
		I2C slave address ucsi

config  ECLITE_UCSI_FRAMEWORK
	bool "Enable ecLite UCSI Framework"
	default n
	help
	Enable eclite UCSI framework

config  ECLITE_UCSI_DBG
	bool "enables ucsi debug log"
	default n
	help
		This turns on the serial logs for debug purposes

config  ECLITE_UCSI_I2C_SLAVE_NAME
	string "I2C for  eclite ucsi device"
	default "I2C_7"
	help
	build settings to enable the UCSI

config  ECLITE_CHG_GPIO_PIN
	int "Gpio for Charger"
	default 10
	help
		Gpio for charger present

config  ECLITE_CHG_CTRL_GPIO_NAME
	string "GPIO Cotroller Name for charger control"
	default  "GPIO_1"
	help
		GPIO controller to be used by charging framework

config  ECLITE_CHG_CTRL_GPIO_PIN
	int "Gpio for Charger Control"
	default 11
	help
		Gpio for charger control

config CHG_I2C_SLAVE_ADDR
	int "I2C slave address for Charger SENS"
	default 10
	help
		I2C slave address charger
config THERMAL_ENABLE
	bool "Enables thermal framework"
	default n
	help
		Enables thermal sensors and drivers. All termal capabilities
		are off when disabled

config  ECLITE_THERMAL_SENSOR_GPIO_PIN
	int "Gpio for Thermal sensor Alert"
	default 12
	help
		Alert Gpio for Thermal sensor

config  ECLITE_THERMAL_SENSOR_GPIO_NAME
	string "GPIO Cotroller Name for BTP"
	default  "GPIO_1"
	help
		GPIO controller to be used by charging framework

config  THERM_SEN_0_I2C_SLAVE_ADDR
	int "I2C slave address for SENS 0"
	default 72
	help
		I2C slave address sensor 0
config  THERM_SEN_1_I2C_SLAVE_ADDR
	int "I2C slave address for SENS 1"
	default 73
	help
		I2C slave address sensor 1
config  THERM_SEN_2_I2C_SLAVE_ADDR
	int "I2C slave address for SENS 2"
	default 74
	help
		I2C slave address sensor 2
config  THERM_SEN_2_I2C_SLAVE_ADDR
	int "I2C slave address for SENS 2"
	default 74
	help
		I2C slave address sensor 2
config  THERM_SEN_3_I2C_SLAVE_ADDR
	int "I2C slave address for SENS 3"
	default 75
	help
		I2C slave address sensor 3

config THERMAL_SHUTDOWN_ENABLE
	bool "Enable thermal shutdown"
	default n
	help
		Enable thermal shutdown

config  CPU_CRIT_SHUTDOWN
	int "Critical shutdown temperature for CPU"
	default 130
	help
		Critical shutdown temperature for CPU

config  SYS_CRIT_SHUTDOWN
	int "Critical shutdown temperature for platform thermistors"
	default 110
	help
		Critical shutdown temperature for platform thermistors

config  ECLITE_BATTERY_CRITICAL_LEVEL
	int "Battery critical level for S3 wake"
	default 10
	help
		Low battery limit in percentage for S3 wake.

config  ECLITE_FAN_PWM_PIN
	int "PWM pin for FAN"
	default 0
	help
		PWM pin for FAN

config  ECLITE_FAN_PWM_NAME
	string "PWM controller for FAN"
	default "PWM_1"
	help
		PWM pin for FAN

config  ECLITE_FAN_TGPIO_PIN
	int "TGPIO pin for FAN"
	default 0
	help
		TGPIO pin for FAN

config  ECLITE_FAN_TGPIO_NAME
	string "TGPIO controller for FAN"
	default "TGPIO_1"
	help
		PWM pin for FAN

config ECLITE_POLLING_TIMER_PERIOD
	int "CPU temperature polling timer interval in milliseconds"
	default 5000
	help
		CPU temperature polling timer interval in milliseconds

config ECLITE_THERMAL_WAKE_SOURCE_PIN
	int "Wake up source for platform thermal sensor GPIO pin"
	default 49
	help
		Wake up source for platform thermal sensor GPIO pin.
		The GPIO pin range is 0 to 76 across all controllers.

config ECLITE_DEBUG
	bool "Enables cpu thermal sensing device"
	default n
	help
		This turns on the serial logs for debug purposes

config ECLITE_THERMAL_DEBUG
	bool "Enables cpu thermal debug log"
	default n
	help
		This turns on the serial logs for debug purposes

config TEST_MODE
	bool "Enables test mode to use dummy value and TGPIO mux setting"
	default n
	help
		This turns on test setting
```

## services/ehl-oob/Kconfig
```kconfig
config OOB_SERVICE
	bool "Enable Out-of-Band"
	default n
	depends on PMC_SERVICE
	help
		Enable Out-of-Band

config OOB_LOGGING
	int "Sets Logging mode for OOB"
	depends on OOB_SERVICE
	default 0 if OOB_SERVICE
	help
	Sets log level for modules which don't specify it explicitly. When
	set to 0 it means log will not be activated for those modules.
	Levels are:
		- 0 OFF, do not write by default
		- 1 ERROR, default to only write LOG_LEVEL_ERR
		- 2 WARNING, default to write LOG_LEVEL_WRN
		- 3 INFO, default to write LOG_LEVEL_INFO
		- 4 DEBUG, default to write LOG_LEVEL_DBG

config SOC_INTEL_PSE
	bool "Platform is Intel PSE"
	default y if OOB_SERVICE

config OOB_BIOS_IPC
	bool "OOB should use OOB_BIOS_IPC Default"
	depends on OOB_SERVICE
	default y if OOB_SERVICE
	help
	Set it to 'y' for default Builds. OOB should Access credentials
	from BIOS.
	depends on OOB_SERVICE
	default n if OOB_SERVICE

config OOB_BIOS_IPC_TIMEOUT
	int "Sets timeout(millisecs) for BIOS IPC startup"
	depends on OOB_SERVICE
	default 60000
	help
	Sets timeout(millisecs) for BIOS IPC startup

config OOB_TLS_DURATION
	int "Sets TLS Session timer expiry duration in HOURS"
	depends on OOB_SERVICE
	default 24
	help
	Sets TLS Session timer expiry duration in HOURS

config OOB_PM_SX_TRANSITION_TIME
	int "Sets timer to track Sx transitions in SECONDS"
	depends on OOB_SERVICE
	default 120
	help
	Sets timer to track Sx transitions in SECONDS

config OOB_TELIT_CLD_HOST
	string "Sets Telit cloud host name"
	default "api-us.devicewise.com" if !OOB_BIOS_IPC
	help
	Sets Telit cloud host name

config OOB_TELIT_TOKEN_ID
	string "Sets device token id"
	default "token_id" if !OOB_BIOS_IPC
	help
	Sets device token id

config OOB_TELIT_USERNAME
	string "Sets device username"
	default "device_id" if !OOB_BIOS_IPC
	help
	Sets device username

config OOB_THINGSBOARD_CLD_HOST
	string "Sets Thingsboard cloud host name"
	default "192.168.1.1" if !OOB_BIOS_IPC
	help
	Sets Thingsboard cloud host name

config OOB_THINGSBOARD_TOKEN_ID
	string "Sets device token id"
	default "" if !OOB_BIOS_IPC
	help
	Sets device token id

config OOB_THINGSBOARD_USERNAME
	string "Sets device username"
	default "access_token" if !OOB_BIOS_IPC
	help
	Sets device username

config OOB_AZURE_IOT_CLD_HOST
	string "Sets Azure IoT cloud host name"
	default "azure_iot.portal.com" if !OOB_BIOS_IPC
	help
	Sets Azure IoT cloud host name

config OOB_AZURE_IOT_TOKEN_ID
	string "Sets device token id"
	default "token_id" if !OOB_BIOS_IPC
	help
	Sets device token id

config OOB_AZURE_IOT_USERNAME
	string "Sets device username"
	default "device_id" if !OOB_BIOS_IPC
	help
	Sets device username

config OOB_CLD_MQTT_CLIENT_ID
	string "Sets Cloud Mqtt Client ID"
	default "client_id" if !OOB_BIOS_IPC
	help
	Sets Cloud Mqtt Client ID

config OOB_CLD_PORT_SECURE
	string "Sets Secure Cloud host port"
	default "8883" if !OOB_BIOS_IPC
	help
	Sets Secure Cloud host port

config OOB_PROXY_URL
	string "Sets Company Proxy"
	default "http://proxy-company.com" if !OOB_BIOS_IPC
	help
	Sets Company Proxy

config OOB_PROXY_PORT
	string "Sets Company Proxy port"
	default "911" if !OOB_BIOS_IPC
	help
	Sets Company Proxy port

if BOARD_SAM_E70_XPLAINED
config OOB_LOGGING
	int "Sets Logging mode for OOB"
	default 4
	help
	Sets log level for modules which don't specify it explicitly. When
	set to 0 it means log will not be activated for those modules.
	Levels are:
		- 0 OFF, do not write by default
		- 1 ERROR, default to only write LOG_LEVEL_ERR
		- 2 WARNING, default to write LOG_LEVEL_WRN
		- 3 INFO, default to write LOG_LEVEL_INFO
		- 4 DEBUG, default to write LOG_LEVEL_DBG

config OOB_BIOS_IPC
	bool "OOB_BIOS_IPC should not be used"
	default n
endif
```

## services/fw_version/Kconfig
```kconfig
# Kconfig - FW Version configuration options
#
# Copyright (c) 2021 Intel Corporation.
#
# SPDX-License-Identifier: Apache-2.0
#

config MISC_FW_VERSION
	bool "print FW Version strings"
	default y
```

## services/sys_service/Kconfig
```kconfig
config SYS_SERVICE
	bool "SYS Service"
	depends on NUM_USER_APP_AND_SERVICE >= 4
	help
		Enable System service.

if SYS_SERVICE
rsource "host_service/Kconfig"
endif
```

## services/sys_service/host_service/Kconfig
```kconfig
# Kconfig - pse-host communication configuration options
#
# Copyright (c) 2021 Intel Corporation
#
# SPDX-License-Identifier: Apache-2.0
#

menu "host_service"

config HOST_SERVICE
	bool "HOST_SERVICE support"
	select IPC
	select IPC_SEDI
	help
	  this option enables pse-host communication support.

if HOST_SERVICE
config SYS_MNG
	bool "System Management Protocol support"
	default y
	help
	  pse-host system management commands handling.

config HOST_TIME_SYNC
	bool "Sync POSIX REALTIME with host UTC time"
	default y
	select POSIX_CLOCK
	help
	  Sync POSIX REALTIME with host UTC time passed by host driver

config HECI
	bool "HECI Protocol support"
	default y
	help
	  host HECI protocol

if HECI
rsource "heci/Kconfig"
endif

endif
endmenu
```

## services/sys_service/host_service/heci/Kconfig
```kconfig
# Kconfig - host communication configuration options
#
# Copyright (c) 2021 Intel Corporation
#
# SPDX-License-Identifier: Apache-2.0
#

comment "pse-host HECI protocol support"

module = HECI
module-str = heci
source "subsys/logging/Kconfig.template.log_config"

config SMHI
	bool "enable the SMHI client"
	default y
	help
		SMHI is a basic system HECI client used by host to get basic
		fw status and info

if SMHI
module = SMHI
module-str = smhi
source "subsys/logging/Kconfig.template.log_config"
endif

config HECI_MSG_DUMP
	bool "if HECI message dumping is neeed for debugging"
	depends on LOG
	help
		this configuration is used for HECI debugging, to print all
		HECI in/out message

config HECI_MAX_MSG_SIZE
	int "max message size of HECI protocol"
	default 4096
	help
		set this to config max message size of HECI protocol

config HECI_PAGE_SIZE
	int "max page size of HECI protocol"
	default 4096
	help
		set this to config page size of HECI protocol,
		equals the page size of pse sram

config HECI_USE_DMA
	bool "if HECI use dma to tranfer dma, as an extension of ipc"
	select DMA
	select DMA_SEDI
	help
		set the HECI_USE_DMA to config HECI to use dma, while data
		length is too long.

config HECI_FLOW_CONTROL_WAIT_TIMEOUT
	int "timeout in ms to wait flow control when send heci message"
	default 5000
	help
		the max time in ms that the heci client message sending will
		wait for the flow control from peer client.

if HECI_USE_DMA
config HECI_DMA_THRESHOLD
	int "the threshold when using dma in HECI"
	default 372
	help
		when data length exceeds the max length of ipc msg size, HECI
		should use dma, and the threshold should no larger than max
		size of ipc msg field.

config DMA_ALIGN_SIZE
	int "dma align size"
	default 32
	help
		dma align size

endif
```

## services/sys_service/pm_service/Kconfig
```kconfig
# Kconfig - PM Service Options
#
# Copyright (c) 2021 Intel Corporation
#
# SPDX-License-Identifier: Apache-2.0
#

menu "PM Service Options"

config PM_SERVICE
	bool "PM Service"
	select SYS_POWER_MANAGEMENT
	select DEVICE_PM
	select RUNTIME_NMI
	select TICKLESS_KERNEL
	help
		pse power management.

module = PM_SERV
module-str = pm_serv
source "subsys/logging/Kconfig.template.log_config"

endmenu
```

## services/sys_service/pmc_service/Kconfig
```kconfig
module = PMC
module-str = pmc
source "subsys/logging/Kconfig.template.log_config"

menu "PMC Service Options"

config PMC_SERVICE
	bool "PMC Service"
	select SYS_SERVICE
	select SIDEBAND
	help
		Provide PMC IPC communication interface.

config PMC_DUMMY_RESP
	bool "PMC Dummy response - only for debugging"
	help
		user can enable dummy PMC response to verify their code flow.

config RUN_PMC_SERV_SUPERVISORY
	bool "RUN PMC Service in supervisory mode"
	default y
	help
		Enable PMC service to run in supervisory mode.

config PMC_MAX_CLIENT
	int "Max number of PMC Client"
	default 2
	help
		Max number of PMC Client supported.

endmenu
```
