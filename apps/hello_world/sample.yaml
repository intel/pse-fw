## services/sys_service/wol/Kconfig
```kconfig
# Kconfig - WOL service options
#
# Copyright (c) 2021 Intel Corporation
#
# SPDX-License-Identifier: Apache-2.0
#

menu "WOL Service Options"

config WOL_SERVICE
	bool "WOL Service"
	select CONFIG_GPIO
	select CONFIG_GPIO_SEDI
	default n
	help
		Enable WOL service.

config GBE0_WOL_SERVICE
	bool "GBE0 WOL Service"
	depends on WOL_SERVICE
	default y
	help
		GBE0 WOL configure.

config GBE1_WOL_SERVICE
	bool "GBE1 WOL Service"
	depends on WOL_SERVICE
	default n
	help
		GBE1 WOL configure.

config RGMII_INT_0
	int "RGMII_INT input GPIO PIN"
	depends on GBE0_WOL_SERVICE
	default 4
	help
		Configure RGMII INT pin.

config RGMII_INT_1
	int "RGMII_INT input GPIO PIN"
	depends on GBE1_WOL_SERVICE
	default 5
	help
		Configure RGMII INT pin.

config GBE0_GPIO_DEV
	string "GPIO driver name"
	default "GPIO_WOL"
	help
		Sets device name for GPIO.

config GBE1_GPIO_DEV
	string "GPIO driver name"
	default "GPIO_WOL"
	help
		Sets device name for GPIO.

config GPIO_INT_DIS_ON_D3_EXIT
	bool "disable gpio interrupt on GBE D3 exit"
	depends on WOL_SERVICE
	default y
	help
	 Disable GPIO interrupt on GBE D3 exit.

endmenu
```

## services/tsn_network_service/Kconfig
```kconfig
menuconfig TSN_NET_SERVICE
	bool "Enable TSN Network Service"
	default n
	depends on ETH_DWC_EQOS && NET_L2_ETHERNET_MGMT
	help
	  Enable TSN network service to initialize MAC address,
	  IP address configuration & TSN parameters configuration
	  from BIOS.

if TSN_NET_SERVICE

module = TSN_NET_SERVICE
module-dep = LOG
module-str = Log level for TSN Network Service
module-help = Sets log level for TSN Network Service.

choice
	prompt "$(module-str)"
	default $(module)_LOG_LEVEL_DEFAULT
	depends on $(module-dep)
	help
	  $(module-help)

config $(module)_LOG_LEVEL_OFF
	bool "Off"
	help
	  Do not write to log.

config $(module)_LOG_LEVEL_ERR
	bool "Error"
	help
	  Only write to log when NET_ERR or LOG_ERR is used.

config $(module)_LOG_LEVEL_WRN
	bool "Warning"
	help
	  Write to log with NET_WARN or LOG_WRN in addition to previous level.

config $(module)_LOG_LEVEL_INF
	bool "Info"
	help
	  Write to log with NET_INFO or LOG_INF in addition to previous levels.

config $(module)_LOG_LEVEL_DBG
	bool "Debug"
	help
	  Write to log with NET_DBG or LOG_DBG in addition to previous levels.

config $(module)_LOG_LEVEL_DEFAULT
	bool "Default"
	help
	  Use default log level.

endchoice

config $(module)_LOG_LEVEL
	int
	default 0 if $(module)_LOG_LEVEL_OFF || !$(module-dep)
	default 1 if $(module)_LOG_LEVEL_ERR
	default 2 if $(module)_LOG_LEVEL_WRN
	default 3 if $(module)_LOG_LEVEL_INF
	default 4 if $(module)_LOG_LEVEL_DBG
	default LOG_DEFAULT_LEVEL if $(module)_LOG_LEVEL_DEFAULT

endif # TSN_NET_SERVICE
```

## services/user_app_framework/Kconfig
```kconfig
menu "General Kernel Options"

config USER_APP_FRAMEWORK
	bool "User mode App framework"
	select STACK_CANARIES
	select TEST_RANDOM_GENERATOR
	help
	  This is a wrapper around Zephyr User mode and
	  memory domain for defining logical Apps and service.

config NUM_USER_APP_AND_SERVICE
	int "Number of user mode App"
	default 0
	help
	  Set how many user mode application needed.

config NUM_USER_SERVICE
	int "Number of user mode service"
	default 0
	help
	  Set how many user mode service needed.
config OVERRIDE_APP_RES_TABLE
	bool "Enable override default Apps resource table"
	default n
	help
	  Enable override default Apps resource table

config MAX_NUM_DEVICE_LIST
	int "Max Number of device access list"
	default 8
	help
	  Max Number of device access list.

config MAX_DEVICE_NAME_LEN
	int "Max length of device name"
	default 14
	help
	  Max length of device name.

config APP_FRAMEWORK_LOG
	int "Enable user mode framework log"
	default 0
	help
	  Enable User mode framework log.

endmenu
```

## west.yml
```yaml
# The west manifest file for upstream Zephyr.
#
# The per-installation west configuration file, .west/config, sets the
# path to the project containing this file in the [manifest] section's
# "path" variable.
#
# You are free to create your own manifest files and put them in any
# repository you want, to create your own custom Zephyr installations.
# For example, you could create a manifest file in your own out of
# tree application directory, which would pull this zephyr repository
# in as an ordinary project.
#
# You can pass your manifest repositories to west init when creating a
# new Zephyr installation. See the west documentation for more
# information.

manifest:
  defaults:
    remote: upstream

  remotes:
    - name: upstream
      url-base: https://github.com/zephyrproject-rtos
    - name: intel_public_github
      url-base: https://github.com/intel

  #
  # Please add items below based on alphabetical order
  projects:
    - name: sedi-drivers
      path: modules/hal/sedi
      revision: pse
      remote: intel_public_github
    - name: zephyr
      path: zephyr
      revision: intel-pse
      remote: intel_public_github
      import:
        name-whitelist:
          - mbedtls
          - cmsis
    - name: rtos-if-drivers
      revision: zephyr-pse
      path: zephyr-iotg
      remote: intel_public_github
  self:
    path: ehl_pse-fw
```
