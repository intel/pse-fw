## CMakeLists.txt
```
# SPDX-License-Identifier: Apache-2.0

cmake_minimum_required(VERSION 3.8.2)

include($ENV{ZEPHYR_BASE}/cmake/app/boilerplate.cmake NO_POLICY_SCOPE)
include_directories($ENV{ZEPHYR_BASE}/subsys/net/l2/)
include_directories($ENV{ZEPHYR_BASE}/subsys/net/ip/)
project(NONE)

target_sources(app PRIVATE src/main.c)
target_sources(app PRIVATE src/upd_arp.c)
target_sources(app PRIVATE src/sock_udp.c)
target_sources(app PRIVATE src/send_ping.c)
```

## sample.yaml
```
# Copyright (c) 2019 Intel Corporation
#
# SPDX-License-Identifier: Apache-2.0


sample:
  description: PSE VNIC test application
  name: pse ethernet
  platforms: intel_pse
common:
    tags: samples
    harness: console
    harness_config:
      type: one_line
tests:
  test:
    tags: samples
```

## prj.conf
```kconfig
CONFIG_ASSERT=y
CONFIG_ENTROPY_GENERATOR=y
CONFIG_NET_CONFIG_INIT_TIMEOUT=10
CONFIG_NET_DEBUG_NET_PKT_ALLOC=y
CONFIG_HECI=y
CONFIG_SYS_SERVICE=y
CONFIG_HOST_SERVICE=y
CONFIG_PMC_SERVICE=y
CONFIG_SYS_MNG=y
CONFIG_SMHI=y
#
#Ethernet configuration
#
CONFIG_ETH_PSE_VNIC=y
CONFIG_ETH_PSE_VNIC_MAC0=0xA8
CONFIG_ETH_PSE_VNIC_MAC1=0x0C
CONFIG_ETH_PSE_VNIC_MAC2=0xD5
CONFIG_ETH_PSE_VNIC_MAC3=0xA4
CONFIG_ETH_PSE_VNIC_MAC4=0x37
CONFIG_ETH_PSE_VNIC_MAC5=0xBF
CONFIG_NET_DEFAULT_IF_ETHERNET=y
CONFIG_NET_TCP_ISN_RFC6528=y
#
# Networking
#
CONFIG_NETWORKING=y

#
# Link layer options
#
CONFIG_NET_L2_ETHERNET=y
CONFIG_NET_L2_ETHERNET_MGMT=y
CONFIG_NET_ARP=y

#
# IP stack
#
CONFIG_NET_LOG=y
CONFIG_NET_IPV6=n
CONFIG_NET_IPV4=y
CONFIG_NET_IF_MAX_IPV4_COUNT=6
CONFIG_NET_DHCPV4=n
CONFIG_NET_SHELL=n
CONFIG_NET_TC_TX_COUNT=2
CONFIG_NET_TC_RX_COUNT=2
CONFIG_NET_TC_MAPPING_STRICT=y
CONFIG_NET_TCP=y
CONFIG_NET_UDP=y
CONFIG_NET_PKT_TX_COUNT=40
CONFIG_NET_PKT_RX_COUNT=40
CONFIG_NET_BUF_TX_COUNT=300
CONFIG_NET_BUF_RX_COUNT=300
CONFIG_NET_PKT_TIMESTAMP=n
CONFIG_NET_CONTEXT_PRIORITY=y

#
# Stack usage
#
CONFIG_NET_MGMT=y
CONFIG_NET_STATISTICS=y
CONFIG_NET_STATISTICS_USER_API=y
CONFIG_NET_STATISTICS_ETHERNET_VENDOR=y

#
# Other Kernel Object Options
#
CONFIG_HEAP_MEM_POOL_SIZE=16384
CONFIG_MAIN_STACK_SIZE=8048
CONFIG_TEST_RANDOM_GENERATOR=y
CONFIG_INIT_STACKS=y
CONFIG_PRINTK=y
CONFIG_NET_MAX_CONTEXTS=10
CONFIG_NET_CONFIG_SETTINGS=y
CONFIG_NET_CONFIG_NEED_IPV6=n
CONFIG_NET_CONFIG_NEED_IPV4=y
CONFIG_NET_CONFIG_MY_IPV4_ADDR="192.168.0.1"
CONFIG_NET_CONFIG_PEER_IPV4_ADDR="192.168.0.2"

#
# Network Libraries
#
CONFIG_NET_SOCKETS=y
CONFIG_NET_SOCKETS_POSIX_NAMES=y
CONFIG_USERSPACE=y
CONFIG_USER_APP_FRAMEWORK=y
CONFIG_NUM_USER_APP_AND_SERVICE=4
CONFIG_HEAP_MEM_POOL_SIZE=16384
CONFIG_MAX_THREAD_BYTES=4
CONFIG_LOG_PROCESS_THREAD_STACK_SIZE=2048
```

## src/main.c
```c
/*
 * Copyright (c) 2020 Intel Corporation.
 *
 * SPDX-License-Identifier: Apache-2.0
 */


/**
 *  @file
 *  @brief Sample Application for VNIC driver.
 *
 *  This example demonstrates sending data over UDP using the VNIC interface.
 *  The VNIC interface  uses HECI/IPC driver for communcation between PSE and
 *  Host. The application repeatedly sends a pings command to  host.
 *  On successfully getting a response to ping, the application sends a simple
 *  message over UDP to the Linux host.
 *  @{
 */


#include <device.h>
#include <errno.h>
#include <init.h>
#include <net/dummy.h>
#include <net/net_core.h>
#include <net/net_ip.h>
#include <net/net_pkt.h>
#include <linker/sections.h>
#include <random/rand32.h>
#include <stddef.h>
#include <string.h>
#include <zephyr.h>

/** Time after which udp application starts after success of ping */
#define APP_TIMEOUT_SEC 10

#define K_SLEEP_DURATION_MS K_MSEC(1000)

/** IP address of the linux host for communication */
#define LINUX_HOST_ADDR "192.168.0.2"



/* @brief update_arp_cache
 *
 * Update the arp table to add hostside IP address and  MAC.
 *
 */
extern void update_arp_cache(void);

/* @brief communication_over_udp_socket
 *
 * The function sends data over udp socket to the host.
 *
 */
extern void communication_over_udp_socket(void);

/* @brief send_ping
 *
 * Send ping to the host.
 *
 */
extern int send_ping(char *ip);


/* @brief main
 *
 * Runs the sample VNIC application
 *
 * Demonstrates communication over the virtual network interface in this
 * application. This applicaton sends message to host after a successful
 * ping.
 *
 */

void main(void)
{

	/* Update the arp cache to add the IP and mac id of host */
	update_arp_cache();
	printk("PSE VNIC Test Application\n");

	/* Keep sending ping request to host till  a successful ping response
	 * is received from the host. For ping to succeed, host side
	 * vnic driver must be installed and  assigned the same IP address as
	 * LINUX_HOST_ADDR and mac address.
	 */
	while (send_ping(LINUX_HOST_ADDR)) {
		k_sleep(K_SLEEP_DURATION_MS);
	}

	/* After a successful ping response from host, send data from the
	 * application in  APP_TIMEOUT_SEC seconds. A corresponding udp receiver
	 * application is required to be started on the host for receiving the
	 * data sent by this application
	 */
	for (int i = 0; i < APP_TIMEOUT_SEC; i++) {
		printk("Starting socket app in %d seconds..\n",
		       (APP_TIMEOUT_SEC - i));
		k_sleep(K_SLEEP_DURATION_MS);
	}

	/* Send data over udp socket. */
	communication_over_udp_socket();
}

/*
 * @}
 */
```

## src/send_ping.c
```c
/*
 * Copyright (c) 2020 Intel Corporation
 *
 * SPDX-License-Identifier: Apache-2.0
 */

/**
 * @file
 * @brief Helper file for VNIC main application.
 * This contains the following functions:
 * remove_ipv4_ping_handler() -- Unregister IPv4 ping handler
 * handle_ipv4_echo_reply()   -- Handle IPv4 echo reply packet
 * ping_ipv4() -- Send ping request to host
 * send_ping() -- Initiate ping send to host and wait for reply
 * @{
 */

/* Local Includes */
#include <logging/log.h>
#include <random/rand32.h>
LOG_MODULE_REGISTER(ping, LOG_LEVEL_INF);
#include "icmpv4.h"
#include "net_private.h"

/** Semaphore for handling ping response timeout */
K_SEM_DEFINE(timeout, 0, 1);

static enum net_verdict handle_ipv4_echo_reply(struct net_pkt *pkt,
					       struct net_ipv4_hdr *ip_hdr,
					       struct net_icmp_hdr *icp_hdr);

/* Ping handler for Internet Protocol version 4 (IPv4) */
static struct net_icmpv4_handler ping4_handler = {
.type = NET_ICMPV4_ECHO_REPLY, .code = 0, .handler = handle_ipv4_echo_reply,
};

/* @brief remove IPv4 ping handler
 *
 * Unregister IPv4 ping handler
 *
 */
static inline void remove_ipv4_ping_handler(void)
{
	net_icmpv4_unregister_handler(&ping4_handler);
}

/* @brief handle IPv4 echo reply
 *
 * Handle received echo reply packet and
 * unregister ping handler.
 *
 */
static enum net_verdict handle_ipv4_echo_reply(struct net_pkt *pkt,
					       struct net_ipv4_hdr *ip_hdr,
					       struct net_icmp_hdr *icmp_hdr)
{
	LOG_INF("Received echo reply from %s to %s",
		log_strdup(net_sprint_ipv4_addr(&NET_IPV4_HDR(pkt)->src)),
		log_strdup(net_sprint_ipv4_addr(&NET_IPV4_HDR(pkt)->dst)));

	k_sem_give(&timeout);
	remove_ipv4_ping_handler();

	net_pkt_unref(pkt);
	return NET_OK;
}

/* @brief send ping request
 *
 * Register IPv4 ping handler and send
 * ping request to host.
 *
 */
static int ping_ipv4(char *host)
{
	struct in_addr ipv4_target;
	int ret;

	/* Convert received string to IP address. */
	if (net_addr_pton(AF_INET, host, &ipv4_target) < 0) {
		return -EINVAL;
	}

	net_icmpv4_register_handler(&ping4_handler);
	ret = net_icmpv4_send_echo_request(
		net_if_ipv4_select_src_iface(&ipv4_target), &ipv4_target,
		sys_rand32_get(), sys_rand32_get(), 0, 0);
	if (ret) {
		LOG_ERR("net_icmpv4_send_echo_request failed");
		remove_ipv4_ping_handler();
	} else {
		LOG_INF("Sent a ping to %s", log_strdup(host));
	}

	return ret;
}

/* @brief send ping to host
 *
 * Initiate ping send to the IP address specified by host string
 * and wait for reply.
 *
 */
int send_ping(char *host)
{
	int ret;

	if (IS_ENABLED(CONFIG_NET_IPV4)) {
		ret = ping_ipv4(host);
		if (ret) {
			if (ret == -EIO) {
				LOG_INF("Cannot send IPv4 ping");
			} else if (ret == -EINVAL) {
				LOG_INF("Invalid IP address");
			}

			return -ENOEXEC;
		}
	}

	/* Wait for ping response */
	ret = k_sem_take(&timeout, K_SECONDS(2));
	if (ret == -EAGAIN) {
		LOG_INF("Ping timeout");
		remove_ipv4_ping_handler();
		return -ETIMEDOUT;
	}

	return 0;
}

/**
 * @}
 */
```

## src/sock_udp.c
```c
/*
 * Copyright (c) 2020 Intel Corporation.
 *
 * SPDX-License-Identifier: Apache-2.0
 */

/**
 * @file
 * @brief Helper file for VNIC main application.
 * This contains the following functions:
 * prepare_sock_v4() -- Create a socket and populate it
 * send_to_host() -- Send data to host over udp
 * communication_over_udp_socket() -- Create a task for sending data to host
 * @{
 */

/* Local Includes */
#include <net/socket.h>
#include <stdio.h>

/* Data to be sent to host over udp socket */
#define TEST_STR "HELLO FROM PSE"

/** Destination port for socket */
#define DST_PORT 4242

/** IP address of the linux host for communication */
#define HOST_IP_ADDRESS "192.168.0.2"

/** Stack size of sender task */
#define STACKSIZE (2048)

/** Priority of udp sender task */
#define UDP_TASK_PRI (12)

/* Sender task stack */
K_THREAD_STACK_DEFINE(sender_stack, STACKSIZE);

/* @brief prepare_sock_v4
 *
 * Create a socket and populate it destination IP address and port number .
 *
 */
static void prepare_sock_v4(const char *addr, uint16_t port, int *sock,
			    struct sockaddr_in *sockaddr)
{
	int rv;

	__ASSERT(addr, "null addr");
	__ASSERT(sock, "null sock");
	__ASSERT(sockaddr, "null sockaddr");

	*sock = socket(AF_INET, SOCK_DGRAM, IPPROTO_UDP);
	__ASSERT(*sock >= 0, "socket open failed");

	sockaddr->sin_family = AF_INET;
	sockaddr->sin_port = htons(port);
	rv = inet_pton(AF_INET, addr, &sockaddr->sin_addr);
	__ASSERT(rv == 1, "inet_pton failed");
}

/* @brief send_to_host
 *
 * The function is entry point for sender task, it sends data over udp and
 * aborts task after sending data.
 *
 */
void send_to_host(void *p1, void *p2, void *p3)
{
	ssize_t sent;
	int dst_sock;
	struct sockaddr_in dst_addr;

	ARG_UNUSED(p1);
	ARG_UNUSED(p2);
	ARG_UNUSED(p3);

	prepare_sock_v4(HOST_IP_ADDRESS, DST_PORT, &dst_sock, &dst_addr);

	printk("Sending data to the destination\n");
	sent = sendto(dst_sock, TEST_STR, strlen(TEST_STR), 0,
		      (struct sockaddr *)&dst_addr, sizeof(dst_addr));
	printk("Sent %d bytes\n", sent);
	if (sent != strlen(TEST_STR)) {
		printk("sendto failed\n");
		goto error;
	}
	k_sleep(K_MSEC(1000));

error:
	close(dst_sock);
	k_thread_abort(k_current_get());
}

static struct k_thread sender_thread_info;

/* @breif communication_over_udp_socket
 *
 * This function creates a task for sending data to the host.
 *
 */
void communication_over_udp_socket(void)
{
	/* Thread id of sender task */
	k_tid_t sender_tid;

	/* Cerate sender task */
	sender_tid =
	    k_thread_create(&sender_thread_info, sender_stack, STACKSIZE,
			    send_to_host, NULL, NULL, NULL, UDP_TASK_PRI, 0,
			    K_MSEC(0));
	if (sender_tid != 0) {
		printk("Thread created by sender =%x\n",
		       (unsigned int)sender_tid);
	} else {
		printk("Thread created by sender failed\n");
	}
}

/**
 * @}
 */
```

## src/upd_arp.c
```c
/*
 * Copyright (c) 2020 Intel Corporation
 *
 * SPDX-License-Identifier: Apache-2.0
 */

/**
 * @file
 * @brief Helper file for VNIC main application.
 * This contains the following functions:
 * net_arp_dev_init() -- Initialize ARP context with driver data
 * if_get_addr() -- Get IPv4 address for the interface provided
 * prepare_arp_reply() -- Populate all fields of ARP reply packet
 * prepare_arp_request() -- Populate all fields of ARP request packet
 * @{
 */

/* Local Includes */
#include "logging/log.h"
LOG_MODULE_REGISTER(net_test, CONFIG_NET_ARP_LOG_LEVEL);
#include <device.h>
#include <errno.h>
#include <ethernet/arp.h>
#include <init.h>
#include <linker/sections.h>
#include <net/net_core.h>
#include <net/net_pkt.h>
#include <net/net_ip.h>
#include <net/dummy.h>
#include <stddef.h>
#include <string.h>
#include <zephyr.h>
#include <zephyr/types.h>
#include "net_private.h"

/* Handler for application data */
static char *app_data = "0123456789";

/* Pointer to pending packet */
static struct net_pkt *pending_pkt;

/* Ethernet address for the link */
static struct net_eth_addr hwaddr = { { 0x46, 0x81, 0x59, 0xfe, 0x95, 0x04 } };

/* Address Resolution Protocol (ARP) context */
struct net_arp_context {
	uint8_t mac_addr[sizeof(struct net_eth_addr)];
	struct net_linkaddr ll_addr;
};

/* @brief ARP device init
 *
 * Initialize ARP context with driver data
 *
 */
int net_arp_dev_init(struct device *dev)
{
	struct net_arp_context *net_arp_context = dev->data;

	net_arp_context = net_arp_context;

	return 0;
}

/* @brief get IPv4 address for given interface
 *
 * Get IPv4 address for the interface provided
 * if a match is found, otherwise return NULL.
 *
 */
static inline struct in_addr *if_get_addr(struct net_if *iface)
{
	int i;

	/* Scan all IPv4 interfaces and return the IP address
	 * if a match is found, otherwise return NULL
	 */
	for (i = 0; i < NET_IF_MAX_IPV4_ADDR; i++) {
		if (iface->config.ip.ipv4->unicast[i].is_used &&
		    iface->config.ip.ipv4->unicast[i].address.family ==
		    AF_INET &&
		    iface->config.ip.ipv4->unicast[i].addr_state ==
		    NET_ADDR_PREFERRED) {
			return &iface->config.ip.ipv4->unicast[i]
			       .address.in_addr;
		}
	}

	return NULL;
}

/* @brief prepare ARP reply
 *
 * Populate all fields of ARP reply packet for the given address
 * and return the filled packet.
 *
 */
static inline struct net_pkt *prepare_arp_reply(struct net_if *iface,
						struct net_pkt *req,
						struct net_eth_addr *addr,
						struct net_eth_hdr **eth_rep)
{
	struct net_pkt *pkt;
	struct net_arp_hdr *hdr;
	struct net_eth_hdr *eth;

	/* Allocate a network packet and buffer at once. */
	pkt = net_pkt_alloc_with_buffer(iface, sizeof(struct net_eth_hdr) +
					sizeof(struct net_eth_hdr) +
					sizeof(struct net_arp_hdr),
					AF_UNSPEC, 0, K_SECONDS(1));
	__ASSERT(pkt, "out of mem reply");

	eth = NET_ETH_HDR(pkt);


	net_buf_add(pkt->buffer, sizeof(struct net_eth_hdr));

	/* Remove data from the beginning of the buffer. */
	net_buf_pull(pkt->buffer, sizeof(struct net_eth_hdr));

	(void)memset(&eth->dst.addr, 0xff, sizeof(struct net_eth_addr));
	memcpy(&eth->src.addr, net_if_get_link_addr(iface)->addr,
	       sizeof(struct net_eth_addr));
	eth->type = htons(NET_ETH_PTYPE_ARP);

	*eth_rep = eth;

	net_buf_add(pkt->buffer, sizeof(struct net_eth_hdr));
	net_buf_pull(pkt->buffer, sizeof(struct net_eth_hdr));

	hdr = NET_ARP_HDR(pkt);

	/* Populate all fields of ARP reply packet. */
	hdr->hwtype = htons(NET_ARP_HTYPE_ETH);
	hdr->protocol = htons(NET_ETH_PTYPE_IP);
	hdr->hwlen = sizeof(struct net_eth_addr);
	hdr->protolen = sizeof(struct in_addr);
	hdr->opcode = htons(NET_ARP_REPLY);

	memcpy(&hdr->dst_hwaddr.addr, &eth->src.addr,
	       sizeof(struct net_eth_addr));
	memcpy(&hdr->src_hwaddr.addr, addr, sizeof(struct net_eth_addr));

	/* Copy source and destination IPv4 addresses. */
	net_ipaddr_copy(&hdr->dst_ipaddr, &NET_ARP_HDR(req)->src_ipaddr);
	net_ipaddr_copy(&hdr->src_ipaddr, &NET_ARP_HDR(req)->dst_ipaddr);

	/* Increment data length of buffer to account for more data at end. */
	net_buf_add(pkt->buffer, sizeof(struct net_arp_hdr));

	return pkt;
}

/* @brief prepare ARP request
 *
 * Populate all fields of ARP request packet for the given address
 * and return the filled packet.
 *
 */
static inline struct net_pkt *prepare_arp_request(struct net_if *iface,
						  struct net_pkt *req,
						  struct net_eth_addr *addr,
						  struct net_eth_hdr **eth_hdr)
{
	struct net_pkt *pkt;
	struct net_arp_hdr *hdr, *req_hdr;
	struct net_eth_hdr *eth, *eth_req;

	/* Allocate a network packet and buffer at once. */
	pkt = net_pkt_alloc_with_buffer(iface, sizeof(struct net_eth_hdr) +
					sizeof(struct net_arp_hdr),
					AF_UNSPEC, 0, K_SECONDS(1));
	__ASSERT(pkt, "out of mem request");

	eth_req = NET_ETH_HDR(req);
	eth = NET_ETH_HDR(pkt);

	/* Remove data from the beginning of the buffer. */
	net_buf_pull(req->buffer, sizeof(struct net_eth_hdr));

	req_hdr = NET_ARP_HDR(req);

	(void)memset(&eth->dst.addr, 0xff, sizeof(struct net_eth_addr));
	memcpy(&eth->src.addr, addr, sizeof(struct net_eth_addr));

	eth->type = htons(NET_ETH_PTYPE_ARP);
	*eth_hdr = eth;

	net_buf_pull(pkt->buffer, sizeof(struct net_eth_hdr));

	hdr = NET_ARP_HDR(pkt);

	/* Populate all fields of ARP request packet. */
	hdr->hwtype = htons(NET_ARP_HTYPE_ETH);
	hdr->protocol = htons(NET_ETH_PTYPE_IP);
	hdr->hwlen = sizeof(struct net_eth_addr);
	hdr->protolen = sizeof(struct in_addr);
	hdr->opcode = htons(NET_ARP_REQUEST);

	(void)memset(&hdr->dst_hwaddr.addr, 0x00, sizeof(struct net_eth_addr));
	memcpy(&hdr->src_hwaddr.addr, addr, sizeof(struct net_eth_addr));

	/* Copy source and destination IPv4 addresses. */
	net_ipaddr_copy(&hdr->src_ipaddr, &req_hdr->src_ipaddr);
	net_ipaddr_copy(&hdr->dst_ipaddr, &req_hdr->dst_ipaddr);

	/* Increment data length of buffer to account for more data at end. */
	net_buf_add(pkt->buffer, sizeof(struct net_arp_hdr));

	return pkt;
}

struct net_arp_context net_arp_context_data;

/* @brief update_arp_chache
 *
 * Updating the arp chache.
 *
 */
void update_arp_cache(void)
{

	struct net_eth_hdr *eth_hdr = NULL;
	struct net_pkt *pkt, *pkt2;
	struct net_if *iface;
	struct net_if_addr *ifaddr;
	struct net_arp_hdr *arp_hdr;
	struct net_ipv4_hdr *ipv4;
	int len;

	struct in_addr dst = { { { 192, 168, 0, 2 } } };
	struct in_addr dst_far = { { { 10, 11, 12, 13 } } };
	struct in_addr dst_far2 = { { { 172, 16, 14, 186 } } };
	struct in_addr src = { { { 192, 168, 0, 1 } } };
	struct in_addr netmask = { { { 255, 255, 255, 0 } } };
	struct in_addr gw = { { { 192, 168, 0, 42 } } };

	net_arp_init();

	iface = net_if_get_default();

	net_if_ipv4_set_gw(iface, &gw);
	net_if_ipv4_set_netmask(iface, &netmask);
	/* Unicast test */
	ifaddr = net_if_ipv4_addr_add(iface, &src, NET_ADDR_MANUAL, 0);
	if (!ifaddr) {
		printk("Cannot add address");
	}

	ifaddr->addr_state = NET_ADDR_PREFERRED;

	len = strlen(app_data);

	/* Application data for testing */
	pkt = net_pkt_alloc_with_buffer(iface,
					sizeof(struct net_ipv4_hdr) + len,
					AF_INET,
					0,
					K_SECONDS(1));
	net_pkt_lladdr_src(pkt)->addr = (uint8_t *)net_if_get_link_addr(iface);
	net_pkt_lladdr_src(pkt)->len = sizeof(struct net_eth_addr);


	ipv4 = (struct net_ipv4_hdr *)net_buf_add(pkt->buffer,
						  sizeof(struct net_ipv4_hdr));
	net_ipaddr_copy(&ipv4->src, &src);
	net_ipaddr_copy(&ipv4->dst, &dst);

	memcpy(net_buf_add(pkt->buffer, len), app_data, len);

	pkt2 = net_arp_prepare(pkt, &NET_IPV4_HDR(pkt)->dst, NULL);

	/* The ARP cache should now have a link to pending net_pkt
	 * that is to be sent after we have got an ARP reply.
	 */
	pending_pkt = pkt;

	/* We could have send the new ARP request but for this test we
	 * just free it.
	 */
	net_pkt_unref(pkt2);

	/* Then a case where target is not in the same subnet */
	net_ipaddr_copy(&ipv4->dst, &dst_far);
	pkt2 = net_arp_prepare(pkt, &NET_IPV4_HDR(pkt)->dst, NULL);

	arp_hdr = NET_ARP_HDR(pkt2);
	net_pkt_unref(pkt2);

	/* Try to find the same destination again, this should fail as there
	 * is a pending request in ARP cache.
	 */
	net_ipaddr_copy(&ipv4->dst, &dst_far);

	/* Make sure prepare will not free the pkt because it will be
	 * needed in the later test case.
	 */
	net_pkt_ref(pkt);

	pkt2 = net_arp_prepare(pkt, &NET_IPV4_HDR(pkt)->dst, NULL);

	net_pkt_unref(pkt2);

	/* Try to find the different destination, this should fail too
	 * as the cache table should be full.
	 */
	net_ipaddr_copy(&ipv4->dst, &dst_far2);

	/* Make sure prepare will not free the pkt because it will be
	 * needed in the next test case.
	 */
	net_pkt_ref(pkt);

	pkt2 = net_arp_prepare(pkt, &NET_IPV4_HDR(pkt)->dst, NULL);

	/* Restore the original address so that following test case can
	 * work properly.
	 */
	net_ipaddr_copy(&ipv4->dst, &dst);

	/* The arp request packet is now verified, create an arp reply.
	 * The previous value of pkt is stored in arp table and is not lost.
	 */
	pkt = net_pkt_alloc_with_buffer(iface, sizeof(struct net_eth_hdr) +
					sizeof(struct net_arp_hdr),
					AF_UNSPEC, 0, K_SECONDS(1));

	arp_hdr = NET_ARP_HDR(pkt);
	net_buf_add(pkt->buffer, sizeof(struct net_arp_hdr));
	net_ipaddr_copy(&arp_hdr->dst_ipaddr, &dst);
	net_ipaddr_copy(&arp_hdr->src_ipaddr, &src);

	pkt2 = prepare_arp_reply(iface, pkt, &hwaddr, &eth_hdr);
	/* The pending packet should now be sent */
	switch (net_arp_input(pkt2, eth_hdr)) {
	case NET_OK:
	case NET_CONTINUE:
		break;
	case NET_DROP:
		break;
	}

	/* Yielding so that network interface TX thread can proceed. */
	k_yield();

	net_pkt_unref(pkt);
}

/**
 * @}
 */
```
